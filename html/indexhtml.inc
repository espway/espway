static const char INDEX_HTML[] ICACHE_RODATA_ATTR =
"<!doctype html>\n"
"<html>\n"
"    <head>\n"
"        <meta charset='us-ascii' />\n"
"        <meta name='viewport' content='width=device-width, initial-scale=1, user-scalable=no' />\n"
"        <title>ESPway</title>\n"
"        <style>\n"
"            html {\n"
"                font-size: 32px;\n"
"            }\n"
"            body {\n"
"                font-family: sans-serif;\n"
"                text-align: center;\n"
"                margin: 0 auto;\n"
"            }\n"
"            button {\n"
"                font-size: 2rem;\n"
"                width: 4rem;\n"
"                height: 3rem;\n"
"            }\n"
"            #cube {\n"
"                transform-style: preserve-3d;\n"
"                position: absolute;\n"
"                width: 200px;\n"
"                height: 200px;\n"
"                margin: 0;\n"
"            }\n"
"            .square {\n"
"                width: 200px;\n"
"                height: 200px;\n"
"                position: absolute;\n"
"                margin: 0 auto;\n"
"            }\n"
"            #square1A, #square1B {\n"
"                background-color: blue;\n"
"            }\n"
"            #square2A, #square2B {\n"
"                background-color: red;\n"
"            }\n"
"            #square3A, #square3B {\n"
"                background-color: green;\n"
"            }\n"
"            #square1A {\n"
"                transform: translate3d(0, 0, 100px);\n"
"            }\n"
"            #square1B {\n"
"                transform: translate3d(0, 0, -100px);\n"
"            }\n"
"            #square2A {\n"
"                transform: rotateY(90deg) translate3d(0, 0, -100px);\n"
"            }\n"
"            #square2B {\n"
"                transform: rotateY(90deg) translate3d(0, 0, 100px);\n"
"            }\n"
"            #square3A {\n"
"                transform: rotateX(90deg) translate3d(0, 0, -100px);\n"
"            }\n"
"            #square3B {\n"
"                transform: rotateX(90deg) translate3d(0, 0, 100px);\n"
"            }\n"
"            #container {\n"
"                margin: 100px auto;\n"
"                width: 200px;\n"
"                height: 200px;\n"
"            }\n"
"        </style>\n"
"    </head>\n"
"    <body>\n"
"        <div id='container'>\n"
"            <div id='cube'>\n"
"                <div class='square' id='square1A'></div>\n"
"                <div class='square' id='square2A'></div>\n"
"                <div class='square' id='square3A'></div>\n"
"                <div class='square' id='square1B'></div>\n"
"                <div class='square' id='square2B'></div>\n"
"                <div class='square' id='square3B'></div>\n"
"            </div>\n"
"        </div>\n"
"        <script>\n"
"            (function() {\n"
"                'use strict'\n"
"                let byId = id => document.getElementById(id)\n"
"                let cube = byId('cube')\n"
"                let scale = 1 / 32768.0\n"
"                let gTransform = ''\n"
"                let ws = new WebSocket('ws://192.168.4.1/ws')\n"
"                ws.binaryType = 'arraybuffer'\n"
"                let sendBytes = bytes => ws.send((new Uint8Array(bytes)).buffer)\n"
"                ws.addEventListener('message', update)\n"
"                ws.addEventListener('open', raf)\n"
"                function update(e) {\n"
"                    if (e.data.byteLength === 8) {\n"
"                        let arr = new Int16Array(e.data)\n"
"                        let q0 = scale * arr[0],\n"
"                            q1 = -scale * arr[2],\n"
"                            q2 = scale * arr[3],\n"
"                            q3 = -scale * arr[1]\n"
"                        let a1 = q0*q0 + q1*q1 - q2*q2 - q3*q3,\n"
"                            a2 = 2 * (q1*q2 - q0*q3),\n"
"                            a3 = 2 * (q1*q3 + q0*q2),\n"
"                            b1 = 2 * (q1*q2 + q0*q3),\n"
"                            b2 = q0*q0 - q1*q1 + q2*q2 - q3*q3,\n"
"                            b3 = 2 * (q2*q3 - q0*q1),\n"
"                            c1 = 2 * (q1*q3 - q0*q2),\n"
"                            c2 = 2 * (q2*q3 + q0*q1),\n"
"                            c3 = q0*q0 - q1*q1 - q2*q2 + q3*q3\n"
"                        gTransform = 'matrix3d(' +\n"
"                            a1 + ',' + b1 + ',' + c1 + ',0,' +\n"
"                            a2 + ',' + b2 + ',' + c2 + ',0,' +\n"
"                            a3 + ',' + b3 + ',' + c3 + ',0,' +\n"
"                            '0,0,0,1)'\n"
"                    }\n"
"                    requestAnimationFrame(raf)\n"
"                }\n"
"                function raf() {\n"
"                    cube.style.transform = gTransform\n"
"                    // request new data\n"
"                    sendBytes([0])\n"
"                }\n"
"            })()\n"
"        </script>\n"
"    </body>\n"
"</html>\n";